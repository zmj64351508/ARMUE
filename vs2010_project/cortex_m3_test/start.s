	AREA MYFIELD, DATA, READWRITE 
MYDATA
	DCD 0xFFFFFFFF

	
	AREA	START, CODE, READWRITE	
	DCD 	1000000
	DCD		START1
TESTDATA
	DCD 	0xBBBBBBBB
	DCD		0xEDEDEDED
	
START1	
	;test for SBC
	;THUMB
	;LDR R1,=MYDATA
	MOV R5,#0xC
	MOV SP,R5
	LDR R2,=TESTDATA
	LDR R2, [R2, #0]
	STR R2, [SP, #0]
	LDR R3,[SP, #0]
	ADD R1,PC
	BLX R1
Label
	MOV R2,R1
	MOV R1,R2
	CMP R2,SP
	MOV PC,LR
	ADD SP,R1
	MOV R2,#0
	ROR R1,R2
	MVN R2,R1
	BIC R1,R2
	
	MUL R1,R2
	
	ADD R1,R2
	ORR R2,R1
	
	MOV R2,LR
	LSR R2,#1
	MOV R3,R2
	CMN R2,R3
	
	MOV R2,LR
	LSR R2,#1
	MOV R3,LR
	ASR R3,#1
	CMP R2,R3
	
	TST R2,R3
	
	LSL R3,#5
	ROR R3,R2
	
	SUB R3,#2
	SBC R2,R3
	
	MOV R2,#1
	MOV R3,#2
	SBC R2,R3

	;test for ADC
	MOV R2,#1
	MOV R3,#1
	ADC R2,R3
	
	MOV R2,LR
	MOV R3,#1
	LSR R2,#1
	ADC R2,R3
	
	MOV R2,#1
	LSL R2,#31
	MOV R3,#1
	ADC R2,R3
	
	MOV R2,LR
	MOV R3,#1
	ADC R2,R3
	
	MOV R2,LR
	MOV R3,LR
	ADC R2,R3
	
	MOV R2,#1
	LSL R2,#31
	ADD R2,#1
	MOV R3,R2
	ADC R2,R3
	
	EOR R2,R3
	
	
	SUB R3,#20
	ADD R2,#20
	ADD R4,#0
	CMP R4,#1
	CMP R3,#1
	CMP R3,#0
	CMP R3,#21
	CMP r5,#0
	ASR R1,R2,#1
	LSL R3,R2,#1
	LSR R1,R2,#1
	LSR R2,R2,#1
	MUL R1,R2
	ASR R3,R2,#2
	ADD R1,R1,R2
	BX	R1
	MOV R1,R2
	END
	
